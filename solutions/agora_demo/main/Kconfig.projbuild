## solutions/agora_demo/main/Kconfig.projbuild
```kconfig
menu "Agora Bot Station duplex audio demo"

config AGORA_DEMO_APP_ID
    string "Agora App ID"
    default ""
    help
        Agora App ID placed in the JWT appID claim.

config AGORA_DEMO_APP_CERT
    string "Agora App Cert"
    default ""
    help
        Agora App Certificate used when dynamic authentication is enabled.
        When dynamic authentication is disabled, use the App ID.

config AGORA_DEMO_WHIP_BASE_URL
    string "Agora WHIP endpoint base URL"
    default "https://ap-webrtc-whip.ap.sd-rtn.com"
    help
        Endpoint origin or base path.

config AGORA_DEMO_BOT_STATION_BASE_URL
    string "Bot Station API base URL"
    default "https://botstation.sh2.agoralab.co/api"
    help
        Device API base URL used for pairing, binding, and conversations.

config AGORA_DEMO_HARDWARE_MODEL
    string "Bot Station hardware model"
    default "esp32-s3-korvo-v2"
    help
        Hardware model reported while requesting a pairing code.

config AGORA_DEMO_WIFI_SSID
    string "Wi-Fi SSID"
    default ""

config AGORA_DEMO_WIFI_PASSWORD
    string "Wi-Fi password"
    default ""

endmenu
```

## solutions/agora_demo/sdkconfig.defaults
```kconfig
# Runtime and external RAM
CONFIG_SPIRAM=y
CONFIG_ESP_SYSTEM_PANIC_GDBSTUB=y
CONFIG_FREERTOS_USE_TRACE_FACILITY=y
CONFIG_FREERTOS_VTASKLIST_INCLUDE_COREID=y
CONFIG_FREERTOS_GENERATE_RUN_TIME_STATS=y

# Network and WebRTC
CONFIG_LWIP_SNTP_MAX_SERVERS=2
CONFIG_LWIP_TCPIP_RECVMBOX_SIZE=64
CONFIG_LWIP_MAX_UDP_PCBS=1024
CONFIG_LWIP_UDP_RECVMBOX_SIZE=64
CONFIG_MBEDTLS_SSL_PROTO_DTLS=y
CONFIG_MBEDTLS_SSL_DTLS_SRTP=y
CONFIG_MBEDTLS_CERTIFICATE_BUNDLE=y

# Allocate large networking buffers in external RAM
CONFIG_SPIRAM_MALLOC_ALWAYSINTERNAL=256
CONFIG_SPIRAM_TRY_ALLOCATE_WIFI_LWIP=y
CONFIG_MBEDTLS_EXTERNAL_MEM_ALLOC=y

# Media and storage
# CONFIG_AUDIO_ENCODER_G711_SUPPORT is not set
# CONFIG_AUDIO_DECODER_G711_SUPPORT is not set
CONFIG_AUDIO_ENCODER_OPUS_SUPPORT=y
CONFIG_AUDIO_DECODER_OPUS_SUPPORT=y
CONFIG_IDF_EXPERIMENTAL_FEATURES=y
CONFIG_PARTITION_TABLE_CUSTOM=y
CONFIG_PARTITION_TABLE_CUSTOM_FILENAME="partitions.csv"
```

## solutions/local_jpeg_stream/sdkconfig.defaults
```kconfig
# Enable SPIRAM
CONFIG_SPIRAM=y

# Enable GDBStub
CONFIG_ESP_SYSTEM_PANIC_GDBSTUB=y

# Enable FreeRTOS trace
CONFIG_FREERTOS_USE_TRACE_FACILITY=y
CONFIG_FREERTOS_VTASKLIST_INCLUDE_COREID=y
CONFIG_FREERTOS_GENERATE_RUN_TIME_STATS=y
CONFIG_FREERTOS_HZ=1000

# Support 2 SNTP
CONFIG_LWIP_SNTP_MAX_SERVERS=2

# Enable DTLS SRTP
CONFIG_MBEDTLS_SSL_PROTO_DTLS=y
CONFIG_MBEDTLS_SSL_DTLS_SRTP=y
CONFIG_MBEDTLS_X509_CREATE_C=y

# Enable ChaCha20-Poly1305 so DTLS can negotiate it and `cipher` CLI can measure it
CONFIG_MBEDTLS_CHACHA20_C=y
CONFIG_MBEDTLS_POLY1305_C=y
CONFIG_MBEDTLS_CHACHAPOLY_C=y

# Use new I2C master
CONFIG_CODEC_I2C_BACKWARD_COMPATIBLE=n

# Enable experimental features
CONFIG_IDF_EXPERIMENTAL_FEATURES=y

# Use customer partition table
CONFIG_PARTITION_TABLE_CUSTOM=y
CONFIG_PARTITION_TABLE_CUSTOM_FILENAME="partitions.csv"

#
# HTTP Server (local signaling)
#
CONFIG_HTTPD_MAX_REQ_HDR_LEN=4096
CONFIG_HTTPD_MAX_URI_LEN=256
CONFIG_HTTPD_SERVER_EVENT_POST_TIMEOUT=100

# Larger receive buffers for media
CONFIG_LWIP_TCPIP_RECVMBOX_SIZE=64
CONFIG_LWIP_MAX_UDP_PCBS=1024
CONFIG_LWIP_UDP_RECVMBOX_SIZE=64

# Allocate LWIP and MbedTLS on SPIRAM
CONFIG_SPIRAM_MALLOC_ALWAYSINTERNAL=256
CONFIG_SPIRAM_TRY_ALLOCATE_WIFI_LWIP=y
CONFIG_MBEDTLS_EXTERNAL_MEM_ALLOC=y
CONFIG_ESP_WIFI_STATIC_RX_BUFFER_NUM=10
CONFIG_ESP_WIFI_STATIC_TX_BUFFER_NUM=10
CONFIG_ESP32_WIFI_STATIC_RX_BUFFER_NUM=10
CONFIG_ESP32_WIFI_STATIC_TX_BUFFER_NUM=10
CONFIG_ESP_WIFI_IRAM_OPT=n
CONFIG_ESP_WIFI_RX_IRAM_OPT=n
CONFIG_ESP32_WIFI_RX_IRAM_OPT=n

CONFIG_AUDIO_DECODER_MP3_SUPPORT=n
CONFIG_AUDIO_DECODER_AMRNB_SUPPORT=n
CONFIG_AUDIO_DECODER_AMRWB_SUPPORT=n
CONFIG_AUDIO_DECODER_FLAC_SUPPORT=n
CONFIG_AUDIO_DECODER_VORBIS_SUPPORT=n
CONFIG_AUDIO_DECODER_ADPCM_SUPPORT=n
CONFIG_AUDIO_DECODER_ALAC_SUPPORT=n
CONFIG_AUDIO_DECODER_PCM_SUPPORT=n
CONFIG_AUDIO_DECODER_SBC_SUPPORT=n
CONFIG_AUDIO_DECODER_LC3_SUPPORT=n
CONFIG_AUDIO_DECODER_G722_SUPPORT=n

CONFIG_AUDIO_ENCODER_AMRNB_SUPPORT=n
CONFIG_AUDIO_ENCODER_AMRWB_SUPPORT=n
CONFIG_AUDIO_ENCODER_ADPCM_SUPPORT=n
CONFIG_AUDIO_ENCODER_ALAC_SUPPORT=n
CONFIG_AUDIO_ENCODER_PCM_SUPPORT=n
CONFIG_AUDIO_ENCODER_SBC_SUPPORT=n
CONFIG_AUDIO_ENCODER_LC3_SUPPORT=n
CONFIG_AUDIO_ENCODER_G722_SUPPORT=n

CONFIG_VIDEO_DECODER_SW_H264_SUPPORT=n
CONFIG_VIDEO_ENCODER_SW_H264_SUPPORT=n
```

## solutions/local_jpeg_stream/sdkconfig.defaults.esp32s3
```kconfig
CONFIG_ESPTOOLPY_FLASHFREQ_120M=y
CONFIG_ESPTOOLPY_FLASHSIZE_4MB=y
CONFIG_SPI_FLASH_HPM_ENA=y
CONFIG_SPI_FLASH_HPM_DC_ON=y
CONFIG_BOOTLOADER_FLASH_DC_AWARE=y

CONFIG_SPIRAM_MODE_OCT=y
CONFIG_SPIRAM_SPEED_120M=y
CONFIG_ESP32S3_SPIRAM_SUPPORT=y

CONFIG_COMPILER_OPTIMIZATION_PERF=y

CONFIG_ESP_DEFAULT_CPU_FREQ_MHZ_240=y
CONFIG_ESP32S3_INSTRUCTION_CACHE_32KB=y
CONFIG_ESP32S3_DATA_CACHE_64KB=y
CONFIG_ESP32S3_DATA_CACHE_LINE_64B=y

CONFIG_FLASHMODE_QIO=y
CONFIG_ESPTOOLPY_FLASHMODE_QIO=y
CONFIG_ESP_WS_CLIENT_ENABLE_DYNAMIC_BUFFER=y

# Heap leak tracing for boot→server-ready (sys_state_heap_trace)
# CONFIG_HEAP_TRACING_STANDALONE=y
# CONFIG_HEAP_TRACING_STACK_DEPTH=7

CONFIG_CAMERA_OV2640=y
CONFIG_CAMERA_OV2640_DVP_JPEG_1280X720_12FPS=y
CONFIG_CAMERA_OV2640_DVP_DEFAULT_FMT_JPEG_1280X720_12FPS=y

CONFIG_CAMERA_OV3660=y
CONFIG_CAMERA_OV3660_DVP_YUV422_YUYV_640X480_10FPS=n
CONFIG_CAMERA_OV3660_DVP_JPEG_1280X720_12FPS=y
CONFIG_CAMERA_OV3660_DVP_DEFAULT_FMT_JPEG_1280X720_12FPS=y
CONFIG_CAMERA_OV3660_DVP_IF_FORMAT_INDEX_DEFAULT=4
```

## solutions/local_jpeg_stream/sdkconfig.defaults.esp32s31
```kconfig
CONFIG_ESPTOOLPY_FLASHSIZE_8MB=y
CONFIG_SPIRAM_MODE_OCT=y
CONFIG_SPIRAM_SPEED_200M=y
CONFIG_CAMERA_OV3660=y
CONFIG_ESP_VIDEO_ENABLE_DVP_VIDEO_DEVICE=y
CONFIG_CAMERA_OV3660_DVP_JPEG_640X480_25FPS=y
CONFIG_CAMERA_OV3660_DVP_DEFAULT_FMT_JPEG_640X480_25FPS=y

## Codec Board Selection
CONFIG_ESP32_S31_S31_KORVO_1_BOARD=y
```
