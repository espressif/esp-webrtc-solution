## components/av_render/examples/render_test/sdkconfig.defaults
```kconfig
# Enable SPIRAM
CONFIG_SPIRAM=y

# Enable GDBStub
CONFIG_ESP_SYSTEM_PANIC_GDBSTUB=y

# Enable FreeRTOS trace
CONFIG_FREERTOS_USE_TRACE_FACILITY=y
CONFIG_FREERTOS_VTASKLIST_INCLUDE_COREID=y
CONFIG_FREERTOS_GENERATE_RUN_TIME_STATS=y
CONFIG_FREERTOS_HZ=1000

# Use new I2C master
CONFIG_CODEC_I2C_BACKWARD_COMPATIBLE=n

# Enable experimental features
CONFIG_IDF_EXPERIMENTAL_FEATURES=y

# Use customer partition table
CONFIG_PARTITION_TABLE_CUSTOM=y
```

## components/av_render/examples/render_test/sdkconfig.defaults.esp32p4
```kconfig
# Flash setting
CONFIG_FLASHMODE_QIO=y
CONFIG_ESPTOOLPY_FLASHSIZE_8MB=y

CONFIG_SPIRAM_SPEED_200M=y

# If you use serial JTAG turn on this option
CONFIG_ESP_CONSOLE_USB_SERIAL_JTAG=y

# Use camera SC2336
CONFIG_CAMERA_SC2336=y
CONFIG_CAMERA_SC2336_MIPI_RAW8_1024X600_30FPS=y

# Enable ISP pipelines
CONFIG_ESP_VIDEO_ENABLE_ISP_PIPELINE_CONTROLLER=y
```

## components/av_render/examples/render_test/sdkconfig.defaults.esp32s3
```kconfig
CONFIG_ESPTOOLPY_FLASHFREQ_120M=y
CONFIG_ESPTOOLPY_FLASHSIZE_8MB=y


CONFIG_SPIRAM_MODE_OCT=y
CONFIG_SPIRAM_SPEED_120M=y
CONFIG_ESP32S3_SPIRAM_SUPPORT=y

CONFIG_COMPILER_OPTIMIZATION_PERF=y

CONFIG_ESP_DEFAULT_CPU_FREQ_MHZ_240=y
CONFIG_ESP32S3_INSTRUCTION_CACHE_32KB=y
CONFIG_ESP32S3_DATA_CACHE_64KB=y
CONFIG_ESP32S3_DATA_CACHE_LINE_64B=y

CONFIG_FLASHMODE_QIO=y
CONFIG_ESPTOOLPY_FLASHMODE_QIO=y

CONFIG_ESP_WS_CLIENT_ENABLE_DYNAMIC_BUFFER=y
```

## components/av_render/examples/render_test/sdkconfig.defaults.esp32s31
```kconfig
CONFIG_ESPTOOLPY_FLASHSIZE_8MB=y
CONFIG_SPIRAM_MODE_OCT=y
CONFIG_SPIRAM_SPEED_200M=y
CONFIG_CAMERA_OV3660=y
CONFIG_ESP_VIDEO_ENABLE_DVP_VIDEO_DEVICE=y
CONFIG_CAMERA_OV3660_DVP_RGB565_BE_640X480_10FPS=y
CONFIG_CAMERA_OV3660_DVP_DEFAULT_FMT_RGB565_BE_640X480_10FPS=y
```

## components/codec_board/Kconfig.projbuild
```kconfig
menu "Codec Board Configuration"

choice
    prompt "Selection for codec board"
    default ESP32_S3_KORVO_V2_BOARD
    help
        Select a codec board
config ESP32_S3_KORVO_V2_BOARD
    depends on IDF_TARGET_ESP32S3
    bool "ESP32 S3 Korvo V2"
config ESP32_S3_KORVO_V4_BOARD
    depends on IDF_TARGET_ESP32S3
    bool "ESP32 S3 Korvo V4"
config ESP32_LYRAT_MINI_V1_BOARD
    depends on IDF_TARGET_ESP32
    bool "ESP32 LyraT Mini V1"
config ESP32_KORVO_V1_BOARD
    depends on IDF_TARGET_ESP32
    bool "ESP32 Korvo V1"
config ESP32_S3_BOX_BOARD
    depends on IDF_TARGET_ESP32S3
    bool "ESP32 S3 BOX"
config ESP32_S3_BOX_3_BOARD
    depends on IDF_TARGET_ESP32S3
    bool "ESP32 S3 BOX 3"
config ESP32_P4_FUNCTION_EV_V14_BOARD
    depends on IDF_TARGET_ESP32P4
    bool "ESP32 P4 Function EV V1.4"
config ESP32_P4_EYE_BOARD
    depends on IDF_TARGET_ESP32P4
    bool "ESP32 P4 EYE"
config ESP32_S3_EYE_BOARD
    depends on IDF_TARGET_ESP32S3
    bool "ESP32 S3 EYE"
config XD_AIOT_C3
    depends on IDF_TARGET_ESP32C3
    bool "XD AIOT C3"
config ESP32_S3_KORVO_2L_BOARD
    depends on IDF_TARGET_ESP32S3
    bool "ESP32 S3 KORVO 2L"
config ESP32_S3_ECHOEAR_BOARD
    depends on IDF_TARGET_ESP32S3
    bool "ESP32 S3 ECHOEAR"
config ATOMS3_ECHO_BASE_BOARD
    depends on IDF_TARGET_ESP32S3
    bool "ATOMS3 ECHO BASE"
endchoice

config CODEC_BOARD
    string
    default "S3_Korvo_V2" if ESP32_S3_KORVO_V2_BOARD
    default "S3_Korvo_V4" if ESP32_S3_KORVO_V4_BOARD
    default "LYRAT_MINI_V1" if ESP32_LYRAT_MINI_V1_BOARD
    default "ESP32_KORVO_V1" if ESP32_KORVO_V1_BOARD
    default "ESP32S3_BOX" if ESP32_S3_BOX_BOARD
    default "ESP32_S3_BOX_3" if ESP32_S3_BOX_3_BOARD
    default "ESP32_P4_DEV_V14" if ESP32_P4_FUNCTION_EV_V14_BOARD
    default "ESP32S3_EYE" if ESP32_S3_EYE_BOARD
    default "XD_AIOT_C3" if XD_AIOT_C3
    default "ESP32_S3_KORVO_2L" if ESP32_S3_KORVO_2L_BOARD
    default "ESP32_S3_EchoEar" if ESP32_S3_ECHOEAR_BOARD
    default "ATOMS3_ECHO_BASE" if ATOMS3_ECHO_BASE_BOARD
    default "ESP32_P4_EYE" if ESP32_P4_EYE_BOARD
    default "DUMMY_CODEC_BOARD"
endmenu
```

## components/esp_peer/examples/peer_demo/sdkconfig.defaults.esp32p4
```kconfig
# Flash setting
CONFIG_FLASHMODE_QIO=y
CONFIG_ESPTOOLPY_FLASHSIZE_4MB=y

CONFIG_SPIRAM_SPEED_200M=y

# Set Slave target type
CONFIG_IDF_SLAVE_TARGET="esp32c6"
CONFIG_SLAVE_IDF_TARGET_ESP32C6=y
CONFIG_PARTITION_TABLE_OFFSET=0x9000
```

## components/esp_webrtc/impl/kvs_signaling/Kconfig
```kconfig
menu "KVS Signaling Configuration"

    config KVS_AWS_ACCESS_KEY_ID
        string "AWS Access Key ID"
        default ""
        help
            AWS Access Key ID for KVS signaling authentication.

    config KVS_AWS_SECRET_ACCESS_KEY
        string "AWS Secret Access Key"
        default ""
        help
            AWS Secret Access Key for KVS signaling authentication.

    config KVS_AWS_SESSION_TOKEN
        string "AWS Session Token"
        default ""
        help
            AWS Session Token for temporary credentials. Leave empty if using
            long-term credentials.

    config KVS_AWS_REGION
        string "AWS Region"
        default "us-east-1"
        help
            AWS region for KVS service endpoint.

    config KVS_CHANNEL_NAME
        string "KVS Channel Name"
        default "demo-channel"
        help
            Name of the KVS signaling channel to use.

endmenu
```

## components/media_lib_sal/Kconfig.projbuild
```kconfig
menu "Media Library Abstract Layer Configuration"

config MEDIA_PROTOCOL_LIB_ENABLE
    bool "Enable Media Protocol Library"
    default "y"

config MEDIA_LIB_MEM_AUTO_TRACE
    bool "Support trace memory automatically after media_lib_sal init"
    default "n"

config MEDIA_LIB_MEM_TRACE_DEPTH
    int
    prompt "Memory trace stack depth" if MEDIA_LIB_MEM_AUTO_TRACE
    depends on MEDIA_LIB_MEM_AUTO_TRACE
    default 3
    help
        Set memory trace depth

config MEDIA_LIB_MEM_TRACE_NUM
    int
    prompt "Memory trace number" if MEDIA_LIB_MEM_AUTO_TRACE
    depends on MEDIA_LIB_MEM_AUTO_TRACE
    default 1024
    help
        Set memory trace number

config MEDIA_LIB_MEM_TRACE_MODULE
    bool "Trace for module memory usage"
    depends on MEDIA_LIB_MEM_AUTO_TRACE
    default y

config MEDIA_LIB_MEM_TRACE_LEAKAGE
    depends on MEDIA_LIB_MEM_AUTO_TRACE
    bool "Trace for memory leakage"
    default y

config MEDIA_LIB_MEM_TRACE_SAVE_HISTORY
    bool "Trace to save memory history"
    depends on MEDIA_LIB_MEM_AUTO_TRACE
    default n

config MEDIA_LIB_MEM_SAVE_CACHE_SIZE
    int
    prompt "Cache buffer size to store save history" if MEDIA_LIB_MEM_TRACE_SAVE_HISTORY
    depends on MEDIA_LIB_MEM_TRACE_SAVE_HISTORY
    default 32768
    help
        Set cache size for memory history

config MEDIA_LIB_MEM_TRACE_SAVE_PATH
    string "Memory trace save path" if MEDIA_LIB_MEM_TRACE_SAVE_HISTORY
    depends on MEDIA_LIB_MEM_TRACE_SAVE_HISTORY
    default "/sdcard/trace.log"
    help
        Set memory trace save path

endmenu
```

## solutions/doorbell_demo/sdkconfig.defaults.esp32p4_eye
```kconfig
# Flash setting
CONFIG_FLASHMODE_QIO=y
CONFIG_ESPTOOLPY_FLASHSIZE_8MB=y

CONFIG_SPIRAM_SPEED_200M=y

# If you use serial JTAG turn on this option
CONFIG_ESP_CONSOLE_USB_SERIAL_JTAG=y

# Use camera SC2336
CONFIG_CAMERA_OV2710=y
CONFIG_CAMERA_OV2710_MIPI_RAW10_1920X1080_25FPS=y

# Enable ISP pipelines
CONFIG_ESP_VIDEO_ENABLE_ISP_PIPELINE_CONTROLLER=y

# Set Slave target type
CONFIG_IDF_SLAVE_TARGET="esp32c6"
CONFIG_SLAVE_IDF_TARGET_ESP32C6=y

CONFIG_ESP_HOSTED_PRIV_SDIO_PIN_CMD_SLOT_1=27
CONFIG_ESP_HOSTED_PRIV_SDIO_PIN_CLK_SLOT_1=28
CONFIG_ESP_HOSTED_PRIV_SDIO_PIN_D0_SLOT_1=29
CONFIG_ESP_HOSTED_PRIV_SDIO_PIN_D1_4BIT_BUS_SLOT_1=30
CONFIG_ESP_HOSTED_PRIV_SDIO_PIN_D2_4BIT_BUS_SLOT_1=31
CONFIG_ESP_HOSTED_PRIV_SDIO_PIN_D3_4BIT_BUS_SLOT_1=32
CONFIG_ESP_HOSTED_SDIO_GPIO_RESET_SLAVE=9
CONFIG_ESP_HOSTED_SDIO_PIN_CMD=27
CONFIG_ESP_HOSTED_SDIO_PIN_CLK=28
CONFIG_ESP_HOSTED_SDIO_PIN_D0=29
CONFIG_ESP_HOSTED_SDIO_PIN_D2=31
CONFIG_ESP_HOSTED_SDIO_PIN_D3=32
CONFIG_ESP_HOSTED_SDIO_PIN_D1=30


# Enable following configuration if support C5 Slave, make sure GPIO matched
# CONFIG_SLAVE_IDF_TARGET_ESP32C5=y
# CONFIG_ESP_HOSTED_SPI_HD_HOST_INTERFACE=y
# CONFIG_ESP_SPI_HD_GPIO_CS=4
# CONFIG_ESP_SPI_HD_GPIO_CLK=5
# CONFIG_ESP_SPI_HD_GPIO_D0=20
# CONFIG_ESP_SPI_HD_GPIO_D1=21
# CONFIG_ESP_SPI_HD_GPIO_D2=22
# CONFIG_ESP_SPI_HD_GPIO_D3=23
# CONFIG_ESP_SPI_HD_GPIO_DATA_READY=32
# CONFIG_ESP_SPI_HD_GPIO_RESET_SLAVE=33
# CONFIG_ESP_SPI_HD_FREQ_ESP32XX=40
# CONFIG_ESP_HOSTED_SPI_HD_PRIV_INTERFACE_4_DATA_LINES=y

## Codec Board Selection
CONFIG_ESP32_P4_EYE_BOARD=y
```

## solutions/doorbell_demo/sdkconfig.defaults.esp32s31
```kconfig
CONFIG_ESPTOOLPY_FLASHSIZE_8MB=y
CONFIG_SPIRAM_MODE_OCT=y
CONFIG_SPIRAM_SPEED_200M=y
CONFIG_CAMERA_OV3660=y
CONFIG_ESP_VIDEO_ENABLE_DVP_VIDEO_DEVICE=y
CONFIG_CAMERA_OV3660_DVP_DEFAULT_FMT_YUV422_YUYV_640X480_10FPS=y

## Codec Board Selection
CONFIG_ESP32_S31_S31_KORVO_1_BOARD=y
```

## solutions/doorbell_local/main/Kconfig
```kconfig
menu "DoorBell Local Demo"

config DOORBELL_SUPPORT_PEDESTRIAN_DETECT
   bool "Support pedestrian detection"
   default n
   depends on IDF_TARGET_ESP32P4 || IDF_TARGET_ESP32S3
   help
      Enable this option to enable pedestrian detection
endmenu
```

## solutions/doorbell_local/sdkconfig.defaults.esp32p4
```kconfig
# Flash setting
CONFIG_FLASHMODE_QIO=y
CONFIG_ESPTOOLPY_FLASHSIZE_8MB=y

CONFIG_SPIRAM_SPEED_200M=y

# If you use serial JTAG turn on this option
#CONFIG_ESP_CONSOLE_USB_SERIAL_JTAG=y

# Use camera SC2336
CONFIG_CAMERA_SC2336=y
CONFIG_CAMERA_SC2336_MIPI_RAW10_1920x1080_25FPS_2_LANE=y

# Enable ISP pipelines
CONFIG_ESP_VIDEO_ENABLE_ISP_PIPELINE_CONTROLLER=y

# Set Slave target type
CONFIG_IDF_SLAVE_TARGET="esp32c6"
CONFIG_SLAVE_IDF_TARGET_ESP32C6=y

# Enable following configuration if support C5 Slave, make sure GPIO matched
# CONFIG_SLAVE_IDF_TARGET_ESP32C5=y
# CONFIG_ESP_HOSTED_SPI_HD_HOST_INTERFACE=y
# CONFIG_ESP_SPI_HD_GPIO_CS=4
# CONFIG_ESP_SPI_HD_GPIO_CLK=5
# CONFIG_ESP_SPI_HD_GPIO_D0=20
# CONFIG_ESP_SPI_HD_GPIO_D1=21
# CONFIG_ESP_SPI_HD_GPIO_D2=22
# CONFIG_ESP_SPI_HD_GPIO_D3=23
# CONFIG_ESP_SPI_HD_GPIO_DATA_READY=32
# CONFIG_ESP_SPI_HD_GPIO_RESET_SLAVE=33
# CONFIG_ESP_SPI_HD_FREQ_ESP32XX=40
# CONFIG_ESP_HOSTED_SPI_HD_PRIV_INTERFACE_4_DATA_LINES=y
```

## solutions/doorbell_local/sdkconfig.defaults.esp32s3
```kconfig
CONFIG_ESPTOOLPY_FLASHFREQ_120M=y
CONFIG_ESPTOOLPY_FLASHSIZE_8MB=y
CONFIG_SPI_FLASH_HPM_ENA=y
CONFIG_SPI_FLASH_HPM_DC_ON=y
CONFIG_BOOTLOADER_FLASH_DC_AWARE=y

CONFIG_SPIRAM_MODE_OCT=y
CONFIG_SPIRAM_SPEED_120M=y
CONFIG_ESP32S3_SPIRAM_SUPPORT=y

CONFIG_COMPILER_OPTIMIZATION_PERF=y

CONFIG_ESP_DEFAULT_CPU_FREQ_MHZ_240=y
CONFIG_ESP32S3_INSTRUCTION_CACHE_32KB=y
CONFIG_ESP32S3_DATA_CACHE_64KB=y
CONFIG_ESP32S3_DATA_CACHE_LINE_64B=y

CONFIG_FLASHMODE_QIO=y
CONFIG_ESPTOOLPY_FLASHMODE_QIO=y

CONFIG_ESP_WS_CLIENT_ENABLE_DYNAMIC_BUFFER=y
```

## solutions/kms_demo/sdkconfig.defaults.esp32s3
```kconfig
CONFIG_ESPTOOLPY_FLASHFREQ_120M=y
CONFIG_ESPTOOLPY_FLASHSIZE_4MB=y


CONFIG_SPIRAM_MODE_OCT=y
CONFIG_SPIRAM_SPEED_120M=y
CONFIG_ESP32S3_SPIRAM_SUPPORT=y

CONFIG_ESP_DEFAULT_CPU_FREQ_MHZ_240=y
CONFIG_ESP32S3_INSTRUCTION_CACHE_32KB=y
CONFIG_ESP32S3_DATA_CACHE_64KB=y
CONFIG_ESP32S3_DATA_CACHE_LINE_64B=y
```

## solutions/openai_demo/main/Kconfig.projbuild
```kconfig
menu "Audio Board Configuration"

choice AUDIO_BOARD
    prompt "Select Audio Board"
    default AUDIO_BOARD_DEFAULT_P4 if IDF_TARGET_ESP32P4
    default AUDIO_BOARD_MUSE_RADIO if IDF_TARGET_ESP32S3 # Default to MUSE_RADIO for S3
    help
        Select the audio board being used with the project.

    config AUDIO_BOARD_DEFAULT_P4
        bool "ESP32-P4-Dev-Board-V1.4 (Default for ESP32-P4)"
        depends on IDF_TARGET_ESP32P4

    config AUDIO_BOARD_S3_KORVO_V2
        bool "S3_Korvo_V2 (Generic ESP32-S3)"
        depends on IDF_TARGET_ESP32S3

    config AUDIO_BOARD_MUSE_RADIO
        bool "MUSE_RADIO (ESP32-S3)"
        depends on IDF_TARGET_ESP32S3

endchoice

endmenu
```

## solutions/peer_demo/sdkconfig.defaults
```kconfig
# Enable SPIRAM
CONFIG_SPIRAM=y

# Enable GDBStub
CONFIG_ESP_SYSTEM_PANIC_GDBSTUB=y

# Enable FreeRTOS trace
CONFIG_FREERTOS_USE_TRACE_FACILITY=y
CONFIG_FREERTOS_VTASKLIST_INCLUDE_COREID=y
CONFIG_FREERTOS_GENERATE_RUN_TIME_STATS=y

# Support 2 SNTP
CONFIG_LWIP_SNTP_MAX_SERVERS=2

# Enable DTLS SRTP
CONFIG_MBEDTLS_SSL_PROTO_DTLS=y
CONFIG_MBEDTLS_SSL_DTLS_SRTP=y
CONFIG_MBEDTLS_X509_CREATE_C=y

# Allow TURNS (TURN-over-TLS) against a self-signed TURN server (lab/testing only).
# Required by esp_peer_default_cfg_t.insecure_skip_turn_cert_verify on ESP targets.
CONFIG_ESP_TLS_INSECURE=y
CONFIG_ESP_TLS_SKIP_SERVER_CERT_VERIFY=y

# Use new I2C master
CONFIG_CODEC_I2C_BACKWARD_COMPATIBLE=n

# Enable experimental features
CONFIG_IDF_EXPERIMENTAL_FEATURES=y

CONFIG_PARTITION_TABLE_SINGLE_APP_LARGE=y

CONFIG_VIDEO_DECODER_SW_H264_SUPPORT=n
CONFIG_VIDEO_ENCODER_SW_H264_SUPPORT=n
```

## solutions/rtmp_demo/sdkconfig.defaults
```kconfig
# Enable SPIRAM
CONFIG_SPIRAM=y

# Enable GDBStub
CONFIG_ESP_SYSTEM_PANIC_GDBSTUB=y

# Enable FreeRTOS trace
CONFIG_FREERTOS_USE_TRACE_FACILITY=y
CONFIG_FREERTOS_VTASKLIST_INCLUDE_COREID=y
CONFIG_FREERTOS_GENERATE_RUN_TIME_STATS=y
CONFIG_FREERTOS_HZ=1000

# DTLS
CONFIG_MBEDTLS_SSL_PROTO_DTLS=y
CONFIG_MBEDTLS_SSL_DTLS_SRTP=y
CONFIG_MBEDTLS_X509_CREATE_C=y

# Enable experimental features
CONFIG_IDF_EXPERIMENTAL_FEATURES=y

# Use customer partition table
CONFIG_PARTITION_TABLE_CUSTOM=y

# Allocate LWIP and MbedTLS on SPIRAM
CONFIG_SPIRAM_MALLOC_ALWAYSINTERNAL=256
CONFIG_SPIRAM_TRY_ALLOCATE_WIFI_LWIP=y
CONFIG_MBEDTLS_EXTERNAL_MEM_ALLOC=y
```

## solutions/rtmp_demo/sdkconfig.defaults.esp32p4
```kconfig
CONFIG_ESPTOOLPY_FLASHSIZE_4MB=y

CONFIG_SPIRAM_SPEED_200M=y
CONFIG_PARTITION_TABLE_OFFSET=0x9000

# If you use serial JTAG turn on this option
CONFIG_ESP_CONSOLE_USB_SERIAL_JTAG=y

# Use camera SC2336
CONFIG_CAMERA_SC2336=y
CONFIG_CAMERA_SC2336_MIPI_RAW10_1920x1080_25FPS_2_LANE=y

# Enable ISP pipelines
CONFIG_ESP_VIDEO_ENABLE_ISP_PIPELINE_CONTROLLER=y

CONFIG_IDF_SLAVE_TARGET="esp32c6"
CONFIG_SLAVE_IDF_TARGET_ESP32C6=y


CONFIG_WIFI_RMT_STATIC_RX_BUFFER_NUM=16
CONFIG_WIFI_RMT_DYNAMIC_RX_BUFFER_NUM=64
CONFIG_WIFI_RMT_DYNAMIC_TX_BUFFER_NUM=64
CONFIG_WIFI_RMT_AMPDU_TX_ENABLED=y
CONFIG_WIFI_RMT_TX_BA_WIN=32
CONFIG_WIFI_RMT_AMPDU_RX_ENABLED=y
CONFIG_WIFI_RMT_RX_BA_WIN=32

CONFIG_LWIP_TCP_SND_BUF_DEFAULT=65534
CONFIG_LWIP_TCP_WND_DEFAULT=65534
```

## solutions/rtsp_demo/sdkconfig.defaults
```kconfig
# Enable SPIRAM
CONFIG_SPIRAM=y

# Enable GDBStub
CONFIG_ESP_SYSTEM_PANIC_GDBSTUB=y

# Enable FreeRTOS trace
CONFIG_FREERTOS_USE_TRACE_FACILITY=y
CONFIG_FREERTOS_VTASKLIST_INCLUDE_COREID=y
CONFIG_FREERTOS_GENERATE_RUN_TIME_STATS=y

# Support 2 SNTP
CONFIG_LWIP_SNTP_MAX_SERVERS=2

# Enable DTLS SRTP
CONFIG_MBEDTLS_SSL_PROTO_DTLS=y
CONFIG_MBEDTLS_SSL_DTLS_SRTP=y
CONFIG_MBEDTLS_X509_CREATE_C=y

# Use new I2C master
CONFIG_CODEC_I2C_BACKWARD_COMPATIBLE=n

# Enable experimental features
CONFIG_IDF_EXPERIMENTAL_FEATURES=y

# Use customer partition table
CONFIG_PARTITION_TABLE_CUSTOM=y

CONFIG_LWIP_TCPIP_RECVMBOX_SIZE=64
CONFIG_LWIP_MAX_UDP_PCBS=1024
CONFIG_LWIP_UDP_RECVMBOX_SIZE=64

# Allocate LWIP and MbedTLS on SPIRAM
CONFIG_SPIRAM_MALLOC_ALWAYSINTERNAL=256
CONFIG_SPIRAM_TRY_ALLOCATE_WIFI_LWIP=y
CONFIG_MBEDTLS_EXTERNAL_MEM_ALLOC=y
```
